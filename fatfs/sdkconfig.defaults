## fatfs/sdkconfig.defaults
```kconfig
#
# Partition Table
#
CONFIG_PARTITION_TABLE_CUSTOM=y
CONFIG_PARTITION_TABLE_CUSTOM_FILENAME="partitions.csv"
CONFIG_PARTITION_TABLE_FILENAME="partitions.csv"
CONFIG_PARTITION_TABLE_OFFSET=0x8000
CONFIG_PARTITION_TABLE_MD5=y

#
# FAT Filesystem support
#
CONFIG_FATFS_LFN_HEAP=y
CONFIG_FATFS_MAX_LFN=255
CONFIG_FATFS_API_ENCODING_ANSI_OEM=y
```

## ftp/main/Kconfig.projbuild
```kconfig
menu "Application Configuration"

	menu "WiFi Settting"

		config ESP_WIFI_SSID
			string "WiFi SSID"
			default "myssid"
			help
				SSID (network name) for the example to connect to.

		config ESP_WIFI_PASSWORD
			string "WiFi Password"
			default "mypassword"
			help
				WiFi password (WPA or WPA2) for the example to use.

		config ESP_MAXIMUM_RETRY
			int "Maximum retry"
			default 5
			help
				Set the Maximum retry to avoid station reconnecting to the AP unlimited when the AP is really inexistent.

	endmenu

	menu "NTP Setting"

		config NTP_SERVER
			string "Hostname for NTP Server"
			default "pool.ntp.org"
			help
				Hostname for NTP Server.

		config LOCAL_TIMEZONE
			int "Your local timezone"
			range -23 23
			default 0
			help
				Your local timezone.  When it is 0, Greenwich Mean Time.

	endmenu

	menu "FTP Server Setting"

		config FTP_SERVER
			string "FTP Server Host"
			default "ftpserver.local"
			help
				FTP Server host name or ip address to connect.

		config FTP_PORT
			int "FTP Server Port"
			default 21
			help
				FTP Server port number to connect.

		config FTP_USER
			string "FTP User Name"
			default "ftpuser"
			help
				FTP User name to use.

		config FTP_PASSWORD
			string "FTP Password"
			default "ftppass"
			help
				FTP Password to use.

        choice FTP_FILE_FORMAT
            prompt "Remote file format"
            default FTP_FILE_FORMAT_JSON
            help
                Select Remote file format.
            config FTP_FILE_FORMAT_JSON
                bool "Using JSON format"
                help
                    Using JSON format
            config FTP_FILE_FORMAT_CSV
                bool "Using CSV format"
                help
                    Using CSV format
        endchoice

	endmenu
	
endmenu
```

## sd_spi/main/Kconfig.projbuild
```kconfig
menu "SD SPI Example Configuration"

	config EXAMPLE_PIN_MOSI
		int "MOSI GPIO number"
		range 0 SOC_GPIO_OUT_RANGE_MAX
		default 23 if IDF_TARGET_ESP32
		default 35 if IDF_TARGET_ESP32S2 || IDF_TARGET_ESP32S3
		default  4 # C3 and others

	config EXAMPLE_PIN_MISO
		int "MISO GPIO number"
		range 0 SOC_GPIO_IN_RANGE_MAX
		default 19 if IDF_TARGET_ESP32
		default 37 if IDF_TARGET_ESP32S2 || IDF_TARGET_ESP32S3
		default  3 # C3 and others

	config EXAMPLE_PIN_CLK
		int "CLK GPIO number"
		range 0 SOC_GPIO_OUT_RANGE_MAX
		default 18 if IDF_TARGET_ESP32
		default 36 if IDF_TARGET_ESP32S2 || IDF_TARGET_ESP32S3
		default  2 # C3 and others

	config EXAMPLE_PIN_CS
		int "CS GPIO number"
		range 0 SOC_GPIO_OUT_RANGE_MAX
		default  5 if IDF_TARGET_ESP32
		default 34 if IDF_TARGET_ESP32S2 || IDF_TARGET_ESP32S3
		default  1 # C3 and others

endmenu
```

## tusb/main/Kconfig.projbuild
```kconfig
menu "Application Configuration"

	config LOCAL_ECHO
		bool "Enable local echo"
		default y
		help
			Enable local echo

endmenu
```
